## ESP32C3wOLED/sdkconfig.defaults
```kconfig
# Target: ESP32-C3
CONFIG_IDF_TARGET="esp32c3"

# FreeRTOS tick rate
CONFIG_FREERTOS_HZ=1000

# Legacy I2C slave driver is always available in ESP-IDF v5.5+
```
